## defconfig
```kconfig
CONFIG_VENDOR_TI=y
CONFIG_COREBOOT_ROMSIZE_KB_128=y
CONFIG_DEFAULT_CONSOLE_LOGLEVEL_8=y
CONFIG_PAYLOAD_FIT=y
CONFIG_PAYLOAD_FILE="fitimage_withcpio.itb"
```

## src/mainboard/ti/beaglebone-black/Kconfig
```kconfig
## SPDX-License-Identifier: GPL-2.0-only

if BOARD_TI_BEAGLEBONE_BLACK

config BOARD_SPECIFIC_OPTIONS
	def_bool y
	select SOC_TI_AM335X
	select BOARD_ROMSIZE_KB_4096
	select MISSING_BOARD_RESET

config MAINBOARD_DIR
	string
	default "ti/beaglebone-black"

config MAINBOARD_PART_NUMBER
	string
	default "Beaglebone Black"

config MAX_CPUS
	int
	default 1

config DRAM_SIZE_MB
	int
	default 256

config UART_FOR_CONSOLE
	int
	default 0

endif # BOARD_TI_BEAGLEBONE_BLACK
```
